## sdkconfig.defaults.task07-local
```kconfig
CONFIG_TBOT_COURSE_MODE_LOCAL_ENDPOINT=y
CONFIG_OTA_URL="http://192.168.0.117:8003/tbot/ota/"
CONFIG_WEBSOCKET_URL="ws://192.168.0.117:8000/tbot/v1/"
```
